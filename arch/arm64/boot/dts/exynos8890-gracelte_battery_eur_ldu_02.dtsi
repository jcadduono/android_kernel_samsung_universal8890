/*
 * SAMSUNG UNIVERSAL5433 board device tree source
 *
 * Copyright (c) 2013 Samsung Electronics Co., Ltd.
 *		http://www.samsung.com
 *
 * This program is free software; you can redistribute it and/or modify
 * it under the terms of the GNU General Public License version 2 as
 * published by the Free Software Foundation.
*/

#include "exynos8890-gracelte_common_battery.dtsi"
/ {
	battery {
		battery,wpc_high_temp = <430 465>;
		battery,wpc_high_temp_recovery = <429 370>;
		battery,wpc_lcd_on_high_temp = <400>;
	};

	max77854-fuelgauge {
		fuelgauge,fg_resistor = <2>;
	};
};
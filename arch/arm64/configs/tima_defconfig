## arch/arm64/configs/tima_defconfig
```kconfig
CONFIG_TIMA=y
CONFIG_TIMA_RKP=y
CONFIG_RKP_KDP=y
CONFIG_RKP_NS_PROT=y
CONFIG_RKP_DMAP_PROT=y
CONFIG_RKP_CFP_JOPP=y
CONFIG_RKP_CFP=y
CONFIG_TIMA_LOG=y
CONFIG_KNOX_KAP=y
CONFIG_SEC_RESTRICT_ROOTING=y
CONFIG_SEC_RESTRICT_SETUID=y
CONFIG_SEC_RESTRICT_FORK=y
CONFIG_SEC_RESTRICT_ROOTING_LOG=y
CONFIG_TZ_ICCC=y
CONFIG_TRUSTONIC_TRUSTED_UI=y
CONFIG_TRUSTONIC_TRUSTED_UI_FB_BLANK=y
CONFIG_SECURE_OS_CONTROL=y
CONFIG_TRUSTED_UI_TOUCH_ENABLE=y
```

## drivers/input/touchscreen/melfas/mms100s/Kconfig
```kconfig
#
# Touchscreen driver configuration
#

config TOUCHSCREEN_MMS100S
        tristate "MELFAS MMS100S Touchscreen"
        depends on I2C
        help
          Say Y here if you have a MELFAS MMS100S touchscreen device in your system.

          If unsure, say N.

          To compile this driver as a module, choose M here: the module will be called mms_ts.
```
